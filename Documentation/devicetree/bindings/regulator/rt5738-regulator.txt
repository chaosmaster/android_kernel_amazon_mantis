## drivers/misc/mediatek/emi/Kconfig
```kconfig
config MTK_EMI
	bool "Enable EMI driver"
	default n
	help
	  Say y here to select this option to enable
	  EMI driver. This is a basic config for other
	  emi drivers. So please enable it with CONFIG_MTK_EMI BWL
	  or CONFIG_MTK_EMI_MPU.

config MTK_EMI_BWL
	bool "Enable EMI bandwidth limiter"
	depends on MTK_EMI
	help
	  Say y here to select this option to enable the EMI bandwidth limiter.
	  This driver can only be enabled when CONFIG_MTK_EMI is enabled.
	  This driver supports to change bandwidth limite settings for different scenairos.
	  This driver is mainly used for BWC.

config MTK_EMI_MPU
	bool "Enable EMI MPU"
	depends on MTK_EMI
	help
	  Say y here to select this option to enable the EMI memory protect function.
	  This driver can only be enabled when CONFIG_MTK_EMI is enabled.
	  This driver supports to set mpu region in kernel.
	  This driver supports to monitor current MPU region settings.

config MTK_EMI_7622
	bool "Enable EMI BWL setting for 7622"
	help
	  Say y here to select the EMI bandwidth
	  settings for 7622. Because of different
	  ddr type and speed, other platform should
	  not enable this config.

config MTK_EMI_8695
	bool "Enable EMI BWL setting for 8695"
	depends on MTK_EMI
	help
	  Say y here to select the EMI bandwidth
	  setting for 8695. Because of different
	  ddr type and speed, other platform should
	  not enable this config.
```

## drivers/misc/mediatek/freqhopping/Kconfig
```kconfig
config MTK8695_FREQ_HOPPING
	bool "MT8695 FREQHOPPING driver"
	depends on MTK_FREQ_HOPPING
	help
	  Freqhopping can help you control some PLLs by freqhopping HW.
```

## drivers/misc/mediatek/irrx/Kconfig
```kconfig
config MTK_IRRX
	bool "support MTK irrx"
	depends on MEDIA_RC_SUPPORT && LIRC
	help
		If the platform is supported for IRRX,
		this configuration should be configured,
		and the IRRX driver configuration should
		be configured as well.

config MTK_IRRX_PLAT
	string "MediaTek irrx register map rely on specific IC"
	depends on MTK_IRRX
	default "default"
	---help---
	  choose which irrx register map you want to use.
	  Every IC has its own irrx register map.
	  So should implement driver rely on specific IC and
	  get register map from ic designer.

config MTK_IRRX_MOUSE_DRAG
	bool "Support MTK IR as drag MOUSE"
	depends on MTK_IRRX
	help
		It support IR as drag mouse.
		When on this mode, you can rotate the viewpoint
		of 360 video by pressing LEFT/RIGHT/UP/DOWN key of IR.
		If this option is set, it will support IR as drag mouse.

source "drivers/misc/mediatek/irrx/nec/Kconfig"
source "drivers/misc/mediatek/irrx/rc5/Kconfig"
source "drivers/misc/mediatek/irrx/rc6/Kconfig"
source "drivers/misc/mediatek/irrx/sirc/Kconfig"
source "drivers/misc/mediatek/irrx/rcmm/Kconfig"
```

## drivers/misc/mediatek/mdp/Kconfig
```kconfig
config MTK_MDP
	bool "use imgresz rotate for scale & rotate"
	help
		This enable use imgresz & rotate HW for scale down picture & rotate
```

## drivers/misc/mediatek/thermal/Kconfig
```kconfig
config MTK_TURNKEY_THERMAL
	bool "MTK_TURNKEY_THERMAL"
	help
	  This is for MTK thermal driver.

config BTS_THERMISTOR
	bool "ntc bts thermistor"
	default n
	help
	  Say Y here if you want to use the external ntc bts thermistor

config AMZN_THERMAL_COOLING
	bool "amzn thermal cooling"
	default n
	help
	  Use this to define what cooling devices to use and register
	  the cooling devices on Amazon platform
```

## drivers/misc/mediatek/trustzone/Kconfig
```kconfig
config HAVE_MTK_IN_HOUSE_TEE_SUPPORT
	bool "Enable MTK in-house TEE Solution"
	def_bool n
	help
	  This option decides if the chip can support MTK TEE.
	  Set to yes if MTK TEE is supported.
	  If you don't know if it is supported, setting to no.
	  This option is needed if you would like to turn on MTK TEE.

config MTK_IN_HOUSE_TEE_SUPPORT
	bool "Enable MTK In House TEE Support"
	depends on HAVE_MTK_IN_HOUSE_TEE_SUPPORT
	default n
	help
	  This enable MTK TEE support.

config MTK_IN_HOUSE_TEE_CRYPTO_DRIVER
	bool "Enable MTK In House TEE Crypto Driver"
	depends on MTK_IN_HOUSE_TEE_SUPPORT
	help
	  This enable sha256 and ctr(aes) crypto driver

config MTEE_CMA_SECURE_MEMORY
	bool "MTEE using CMA for secure memory allocation"
	depends on OF
	depends on CMA
	depends on MTK_IN_HOUSE_TEE_SUPPORT
	help
	  Enable allocation secure memory from CMA to free the memory
	  back to Linux CMA when secure memory buffer was not used.

config MTK_DRM_KEY_MNG_SUPPORT
	bool "Enable MTK DRM Key Manager Support"
	depends on (MTK_IN_HOUSE_TEE_SUPPORT) || (TRUSTONIC_TEE_SUPPORT) || (TRUSTY)
	default n
	help
	  This enable MTK DRM Key Manager Support.
	  depending on MTK In-House TEE Support
	  or Trustonic TEE Support
```

## drivers/misc/mediatek/video/Kconfig
```kconfig
menuconfig MTK_FB
	bool "MediaTek Framebuffer Driver"
	depends on FB
	select FB_CFB_FILLRECT
	select FB_CFB_COPYAREA
	select FB_CFB_IMAGEBLIT
	select FB_SOFT_CURSOR
	---help---
	  This selects the MediaTek(R) frame buffer driver.
	  If you want to use MediaTek(R) frame buffer diver, say Y here.
	  If unsure, say N.

config MTK_FB_SUPPORT_ASSERTION_LAYER
	bool "AEE Assertion Layer Support"
	depends on MTK_FB
	select FONT_SUPPORT
	select FONT_8x16
	default y
	---help---
		This enable support for AEE assertion layer.
		If you want to enable AEE assertion layer support, say Y here.
		If unsure, say N.
```

## drivers/misc/mediatek/vq/Kconfig
```kconfig
config MTK_VQ
	bool "use nr di for noise reduction & deinterlace"
	help
		This enable use NR & DI HW for video noise reduction & deinterlace
```

## drivers/staging/amazon/Kconfig
```kconfig
menu "Amazon"

config AMAZON
	bool "Amazon Drivers"
	default n
	---help---
		Enable support for various drivers needed on the Amazon Fire OS
		platform

if AMAZON

config AMAZON_METRICS_LOG
	bool "Amazon Metrics logger driver"
	select RING_BUFFER
	default n
	---help---
		Enable Amazon Metrics/Vitals logger driver

config AMAZON_METRICS_LOG_TEST
	tristate "Amazon Metrics logger driver test module"
	depends on AMAZON_METRICS_LOG
	default n
	---help---
		Enable Amazon Metrics/Vitals logger test module

config AMAZON_SIGN_OF_LIFE
	bool "Amazon Sign of Life"
	default n
	help
		Enable the life cycle metrics to log device boot and
		shutdown information

endif # if AMAZON

endmenu
```
